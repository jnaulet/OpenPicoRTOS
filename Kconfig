## Kconfig
```kconfig
#
# For a description of the syntax of this configuration file,
# see docs/kbuild/kconfig-language.txt.
#
mainmenu "OpenPicoRTOS v1.9.x Configuration"

# comment "Compiler: $(CC_VERSION_TEXT)"
# source "scripts/Kconfig.include"

source arch/Kconfig
source scheduler/Kconfig

menu "General setup"

config SYSCLK_HZ
       int "Core clock frequency"
       default 100000000
       help
          Some help here

config TICK_HZ
       int "System tick frequency (in hertz)"
       default 1000
       help
          Some more help here

config TASK_COUNT
       int "Max number of tasks"
       default 5
       help
          OpenPicoRTOS is fully static and need to know how many tasks
          will run in advance

config DEFAULT_STACK_COUNT
       int "Default size of a task stack"
       default 128
       help
          This has no effect unless you use CONFIG_DEFAULT_STACK_COUNT
          in your program. This represents the size of the default
          stack in number of register-sized element (not bytes)

config DEADLOCK_COUNT
       int "Deadlock counter"
       default 1000
       help
          Number of attempts the system will do before giving up and
          declaring deadlock. This is used by IPCs, notably.

endmenu

menu "Build configuration"

config CROSS_COMPILE
        string "Cross-compiler tool prefix"
        default arm-none-eabi- if ARM
        default avr- if AVR && ATMEGA
        default xc8- if AVR && ATTINY
        default x32- if MIPS
        default riscv64-unknown-elf- if RISCV
        default '' if PTHREAD
        default i686-w64-mingw32- if WIN32
        help
          Same as running 'make CROSS_COMPILE=prefix-' but stored for
          default make runs in this kernel build directory.  You don't
          need to set this unless you want the configured kernel build
          directory to select the cross-compiler automatically.

choice
        prompt "Optimization level"
        default CC_NO_OPTIMIZATION

config CC_NO_OPTIMIZATION
       bool "No optimization (-O0)"

config CC_OPTIMIZE_FOR_SIZE
       bool "Optimize for size (-Os)"

config CC_OPTIMIZE_FOR_PERFORMANCE1
       bool "Optimize for speed (-O1)"

config CC_OPTIMIZE_FOR_PERFORMANCE2
       bool "Optimize for speed (-O2)"

config CC_OPTIMIZE_FOR_PERFORMANCE3
       bool "Optimize for speed (-O3)"

endchoice

config DEBUG
       bool "Build with debug information (-g3)"
       default y

config NDEBUG
       bool "No breakpoints on failed asserts"
       default n
       help
          By default, OpenPicoRTOS triggers a breakpoint everytime
          an assert fails. This is Ok for debug, but rarely for
          production. You might want to select this for your
          final build

config MAP
       bool "Generate Map"
       default n

config EXTRA_CFLAGS
       string "EXTRA_CFLAGS"
       default ""

config LDSCRIPT
       string "Linker script path"
       default "${srctree}/samples/ldscripts/rp2040_flash_xip.ld" if MACH_RP2040
       default "${srctree}/samples/ldscripts/atsam3x8e_flash_xip.ld" if MACH_ATSAM3X8E
       default "${srctree}/samples/ldscripts/atsamd51g19a_flash_xip.ld" if MACH_ATSAME5X
       default "${srctree}/samples/ldscripts/stm32h743_flash_xip.ld" if MACH_STM32H7XX

config EXTRA_LDFLAGS
       string "EXTRA_LDFLAGS"
       default ""

endmenu

source ipc/Kconfig # IPCs
source drivers/Kconfig # Device drivers
source staging/Kconfig # Staging tree
```

## arch/8051/Kconfig
```kconfig
menu "8051 architecture"
     depends on 8051

choice
        prompt "MCU series"
        default MACH_UCSIM51

config MACH_UCSIM51
       bool "SDCC uCSim_51"

config MACH_N76E003
       bool "Nuvoton N76E003 Series"

config MACH_MS51
       bool "Nuvoton MS51 Series"

config MACH_CY7C6801xA
       bool "Cypress CY7C6801xA Series"

config MACH_STC12C5AXX
       bool "STC MCU STC12CA5xx Series"
       
config MACH_CH552
       bool "WCH CH552 Series"

endchoice

config XDATA_SIZE
       int "Amount of RAM allocated for XDATA"
       depends on MACH_CY7C6801xA
       default 2048

config SYSCLK_HZ
       int "Main clock frequency"
       depends on MACH_STC12C5AXX
       default 22100000

config SYSCLK_DIV
       int "Clock source divider (1-128)"
       range 1 128
       default 1
       depends on MACH_STC12C5AXX

endmenu
```

## arch/arm/Kconfig
```kconfig
menu "ARM architecture"
	depends on ARM

choice
        prompt "CPU series"
        default ARMV6M

config ARMV6M
       bool "ARMv6-M series"

config ARMV7M
       bool "ARMv7-M series"

config ARMV7EM
       bool "ARMv7E-M series"

endchoice

source arch/arm/armv6-m/Kconfig
source arch/arm/armv7-m/Kconfig
source arch/arm/armv7e-m/Kconfig

config L1_CACHE_LINESIZE
       int "Data cache line size"
       depends on ARMV7EM
       default 32 if (MACH_STM32H7XX || MACH_STM32L4X)
       default 16 if (MACH_ATSAME5X || MACH_STM32F401X)
       default 4 if MACH_RENESAS_RA4

config CACHE_MAINTENANCE
       bool "Cache maintenance operations"
       depends on ARMV7EM
       default y if (MACH_STM32H7XX || MACH_STM32L4X)
       default n if (MACH_ATSAME5X || MACH_RENESAS_RA4)

config STUB_NEWLIB_4_4_0
       bool "Stub newlib-4.4.0 I/O calls (recommended)"
       default y
       depends on ARM
       help
         newlib-4-4.0 requires functions for _read, _write, _sbrk,
         _close & _lseek, which picoRTOS doesn't provide.
         Stubbing these calls is the quick and easy way to get out
         of this mess

endmenu
```

## arch/arm/armv7-m/Kconfig
```kconfig
choice
	prompt "ARMV7-M device"
	depends on ARMV7M

config MACH_ATSAM3X8E
       bool "Atmel ATSAM3X8E"

config MACH_STM32F10XXX
       bool "STMicro STM32F10xxx Series"

endchoice
```

## arch/arm/armv7e-m/Kconfig
```kconfig
choice
	prompt "ARMV7E-M device"
	depends on ARMV7EM

config MACH_ATSAME5X
       bool "Atmel ATSAME5x/D5x Series"

config MACH_STM32H7XX
       bool "STMicro STM32H7XX Series"

config MACH_RENESAS_RA4
       bool "Renesas RA4 Series"

config MACH_STM32F401X
       bool "STMicro STM32F401x Series"

endchoice

choice
	depends on ARMV7EM
	prompt "FPU support"

config FPV4_SP_D16
       bool "fpv4-sp-d16"

config FPV5_SP_D16
       bool "fpv5-sp-d16"

endchoice
```

## arch/avr/Kconfig
```kconfig
menu "AVR8 architecture"
     depends on AVR

config ATTINY
       bool
       
config ATMEGA
       bool

choice
        prompt "Select device"

config MACH_ATMEGA2560
       bool "Atmel ATMega2560"
       select ATMEGA

config MACH_ATMEGA328P
       bool "Atmel ATMega328p"
       select ATMEGA
       
config MACH_ATMEGA32U4
       bool "Atmel ATMega32u4"
       select ATMEGA
       
config MACH_ATTINY88
       bool "Atmel ATTiny88"
       select ATTINY
       
config MACH_ATTINY414
       bool "Atmel ATTiny414"
       select ATTINY
       
config MACH_ATTINY817
       bool "Atmel ATTiny817"
       select ATTINY

config MACH_ATTINY1607
       bool "Atmel ATTiny1607"
       select ATTINY

config MACH_LGT8FX8P
       bool "LogicGreen LGT8FX8P"
       select ATMEGA

endchoice

config SYSCLK_HZ
       int "Main clock frequency"
       depends on MACH_ATMEGA2560 || MACH_ATMEGA328P || \
                  MACH_ATMEGA32U4 || MACH_ATTINY88
       default 16000000

endmenu
```

## arch/c2000/Kconfig
```kconfig
menu "TI C2000 architecture"
     depends on C2000

choice
        prompt "CPU series"
        default C28X

config C28X
       bool "TI C2000/C28x series"

endchoice

source arch/c2000/c28x/Kconfig

endmenu
```

## arch/c2000/c28x/Kconfig
```kconfig
choice
	prompt "C28x device"
	depends on C28X

config MACH_F28379X
       bool "TMS320F28379X"
       
endchoice

config C28X_FPU
       bool "Support for FPU"
       depends on C28X
       select C28X_EABI

config C28X_EABI
       bool "Support for EABI"
       depends on C28X
       default n
```

## arch/hcs08/Kconfig
```kconfig
menu "HCS08 architecture"
     depends on HCS08

choice
        prompt "MCU series"
        default MACH_MC9S08PT60

config MACH_MC9S08PT60
       bool "NXP MC9S08PT60"
       select MACH_MC9S08PTXX

config MACH_MC9S08PT32
       bool "NXP MC9S08PT32"
       select MACH_MC9S08PTXX

endchoice

config MACH_MC9S08PTXX
       bool

choice
        prompt "SysTick clock selection"
	default MACH_MC9S08PTXX_MTIM1
	depends on MACH_MC9S08PTXX

config SYSTICK_MC9S08PTXX_MTIM1
       bool "Use MTIM1 as SysTick clock"

config SYSTICK_MC9S08PTXX_RTC
       bool "Use RTC as SysTick clock"

endchoice

endmenu
```

## arch/mips/Kconfig
```kconfig
menu "MIPS architecture"
     depends on MIPS

choice
        prompt "CPU series"
        default M51XX

config M51XX
       bool "MIPS32 M51xx series"

endchoice
 
source arch/mips/m51xx/Kconfig

endmenu
```

## arch/mips/m51xx/Kconfig
```kconfig
choice
	prompt "M51xx device"
	depends on M51XX

config MACH_PIC32MZ
       bool "PIC32MZ Family"
       
endchoice

config M51XX_DSP
       depends on M51XX
       default y
       bool "Support for DSP"

config M51XX_FPU64
       depends on M51XX
       default y
       bool "Support for FPU64"
```

## arch/pthread/Kconfig
```kconfig
menu "PTHREAD simulation"
     depends on PTHREAD

choice
        prompt "System"
        default PTHREAD_LINUX

config PTHREAD_LINUX
       bool "Linux pthreads"

endchoice

endmenu
```

## arch/riscv/Kconfig
```kconfig
menu "RISC-V architecture"
     depends on RISCV

choice
        prompt "CPU series"
        default RV32IMAC

config RV32IMAC
       bool "RISC-V RV32IMAC series"

config RV32EC
       bool "RISC-V RV32EC series"

endchoice

source arch/riscv/rv32imac/Kconfig
source arch/riscv/rv32ec/Kconfig

endmenu
```

## arch/riscv/rv32ec/Kconfig
```kconfig
choice
	prompt "RV32EC device"
	depends on RV32EC

config MACH_CH32V003
       bool "WinChipHead CH32V003"

endchoice

config RV32EC_LIBGCC_DIV_MULT
       bool "Provide libgcc files for software div & mult (older GCCs)"
       default y
       depends on RV32EC
       help
       On some older versions of GCC, software division & multiplication
       is not implemented, this provides the files/hooks
```

## arch/riscv/rv32imac/Kconfig
```kconfig
choice
	prompt "RV32IMAC device"
	depends on RV32IMAC

config MACH_GD32VF103
       bool "GigaDevice GD32VF103"
       
endchoice
```

## arch/stm8/Kconfig
```kconfig
menu "STM8 architecture"
     depends on STM8

choice
        prompt "MCU series"
        default MACH_STM8S

config MACH_STM8S
       bool "STMicro STM8S/AF Series"

endchoice

endmenu
```

## arch/win32/Kconfig
```kconfig
menu "WIN32 simulation"
     depends on WIN32

choice
        prompt "System"
        default WINTHREADS

config WINTHREADS
       bool "Linux pthread"

endchoice

endmenu
```

## devices/Kconfig
```kconfig
menu "Device configuration"

source devices/atmel/Kconfig
source devices/gigadevice/Kconfig
source devices/microchip/Kconfig
source devices/raspberry/Kconfig
source devices/ti/Kconfig

config EXECUTE_IN_PLACE
       bool "Execute in place (XIP)"
       default y

endmenu
```

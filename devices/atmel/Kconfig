## devices/atmel/Kconfig
```kconfig
choice
        prompt "Device selection"
        default DEVICE_CUSTOM

config DEVICE_CUSTOM
       bool "Custom device"

config DEVICE_ATMEGA2560
       bool "Atmel ATMega2560"
       depends on AVR && ATMEGA
       select EXECUTE_IN_PLACE
 
config DEVICE_ATMEGA328P
       bool "Atmel ATMega328P"
       depends on AVR && ATMEGA
       select EXECUTE_IN_PLACE
 
config DEVICE_ATMEGA32U4
       bool "Atmel ATMega32u4"
       depends on AVR && ATMEGA
       select EXECUTE_IN_PLACE
        
config DEVICE_ATSAM3X8E
       bool "Atmel ATSAM3X8E"
       depends on ARM && ARM_CORTEX_M3

config DEVICE_ATSAMD51
       bool "Atmel ATSAMD51"
       depends on ARM && ARM_CORTEX_M4F
       select CMCC
       
config DEVICE_ATTINY1607
       bool "Atmel ATTiny1607"
       depends on AVR && ATTINY
       select EXECUTE_IN_PLACE
 
config DEVICE_ATTINY817
       bool "Atmel ATTiny817"
       depends on AVR && ATTINY
       select EXECUTE_IN_PLACE
       
endchoice

source devices/atmel/atsamd51/Kconfig

config LDSCRIPT
       string "Linker script"
       default atmel-custom.ld
       depends on DEVICE_CUSTOM

config STARTUP
       string "Startup file"
       default atmel-custom_startup.S
       depends on DEVICE_CUSTOM
```

## devices/atmel/atsamd51/Kconfig
```kconfig
choice
	prompt "MCU variant"
	default ATSAMD51G19A
	depends on ATSAMD51

config ATSAMD51G18A
       bool "ATSAMD51G18A"

config ATSAMD51G19A
       bool "ATSAMD51G19A"

endchoice

config ATSAMD51G19A_ARDUINO
       bool "Preserve Arduino bootloader"
       default y
       depends on ATSAMD51G19A
```

## drivers/Kconfig
```kconfig
menu "Device drivers"

source drivers/adc/Kconfig
source drivers/can/Kconfig
source drivers/clock/Kconfig
source drivers/dma/Kconfig
# source drivers/dmasg/Kconfig
source drivers/eeprom/Kconfig
source drivers/flash/Kconfig
source drivers/gpio/Kconfig
source drivers/misc/Kconfig
source drivers/mux/Kconfig
source drivers/pwm/Kconfig
source drivers/spi/Kconfig
source drivers/twi/Kconfig
source drivers/uart/Kconfig
source drivers/wd/Kconfig

endmenu
```

## drivers/adc/Kconfig
```kconfig
menu "ADC drivers"

config ADC_AVR
       depends on AVR
       bool "AVR/ATMega series ADC"

config ADC_PIC32MX
       depends on MIPS
       bool "PIC32Mx series ADC"

config ADC_RP2040
       depends on ARM
       bool "RP2040 ADC"

config ADC_SAM3X
       depends on ARM
       bool "ATSAM3x series ADC"

config ADC_SAME5X
       depends on ARM
       bool "ATSAME5/D5x series ADC"

config ADC_TINYAVR
       depends on AVR
       bool "TinyAVR/ATTiny series ADC"

config ADC_TI_TYPE4
       depends on C2000
       bool "TI Type4 ADC"

config ADC_RENESAS_RA4
       depends on ARM
       bool "Renesas RA4 Series ADC"

endmenu
```

## drivers/can/Kconfig
```kconfig
menu "CAN drivers"

config CAN_TI_DCAN
       depends on C2000 || ARM
       bool "TI DCAN"

config CAN_ATSAM3X
       depends on ARM
       bool "ATSAM3x series CAN"

config CAN_NXP_FLEXCAN
       depends on POWERPC || ARM
       bool "NXP FlexCAN CAN"

config CAN_BOSCH_MCAN
       depends on POWERPC || ARM
       bool "BOSCH M_CAN support"
       help
         Boscch M_CAN IP, used on various MCUs like STM32H7 series
	 and Atmel SAMV70 series, among others

endmenu
```

## drivers/clock/Kconfig
```kconfig
menu "Clock drivers"

config CLOCK_ATMEGA2560
       depends on AVR
       bool "ATMega2560 clock"

config CLOCK_ATMEGA328P
       depends on AVR
       bool "ATMega328P clock"

config CLOCK_F28379X
       depends on C2000
       bool "TI TMS320F28379x clock"

config CLOCK_GD32VF103
       depends on RISCV
       bool "GD32VF103 clock"

config CLOCK_PIC32MX
       depends on MIPS
       bool "PIC32Mx clock"

config CLOCK_RP2040
       depends on ARM
       bool "Raspberry RP2040 clock"

config CLOCK_ATSAM3X
       depends on ARM
       bool "ATSAM3x series clock"

config CLOCK_ATSAME5X
       depends on ARM
       bool "ATSAME5x/D5x series clock"

config CLOCK_STM32H7XX
        depends on ARM
        bool "STM32H7xx series clock"

config CLOCK_TINYAVR
       depends on AVR
       bool "TinyAVR/ATTiny series clock"

config CLOCK_RENESAS_RA4
       depends on ARM
       bool "Renesas RA4 clock"

endmenu
```

## drivers/dma/Kconfig
```kconfig
menu "DMA drivers"

config DMA_GD32VF103
       depends on RISCV
       bool "GD32VF103 series DMA"

config DMA_RP2040
       depends on ARM
       bool "Raspberry RP2040 DMA"

config DMA_ATSAME5X
       depends on ARM
       bool "ATSAME5x/D5x series DMA"

config DMA_STM32H7XX
       depends on ARM
       bool "STM32H7xx series DMA"

config DMA_TI_F28X
       depends on C2000
       bool "TI TMS320F28x series DMA"

config DMA_NXP_EDMA
       depends on POWERPC
       bool "NXP eDMA DMA"

endmenu
```

## drivers/eeprom/Kconfig
```kconfig
menu "EEPROM drivers"

config EEPROM_AVR
       depends on AVR
       bool "AVR EEPROM"
       
config EEPROM_CY15B004J
       bool "Cypress CY15B004J EEPROM"
       
endmenu
```

## drivers/flash-ext/Kconfig
```kconfig
menu "External flash drivers"
       
config FLASH_EXT_SST26VF
       bool "Microchip SST26VF series support"
       
config FLASH_EXT_S25FL1
       bool "SPANSION S25FL1 support"

endmenu
```

## drivers/flash/Kconfig
```kconfig
menu "Flash drivers"

config FLASH_GD32VF103
       depends on RISCV
       bool "GD32VF103 series flash"

config FLASH_PIC32MX
       depends on MIPS
       bool "PIC32Mx series flash"

config FLASH_SAME5X
       depends on ARM
       bool "SAME5x/D5x series flash"

endmenu
```

## drivers/gpio/Kconfig
```kconfig
menu "GPIO drivers"

config GPIO_AVR
       depends on AVR
       bool "AVR/ATMega series GPIOs"

config GPIO_GD32VF103
       depends on RISCV
       bool "GD32VF103 series GPIOs"

config GPIO_PIC32MX
       depends on MIPS
       bool "PIC32Mx series GPIOs"

config GPIO_RP2040
       depends on ARM
       bool "Rapspberry RP2040 series GPIOs"

config GPIO_ATSAM3X
       depends on ARM
       bool "ATSAM3x series GPIOs"

config GPIO_ATSAME5X
       depends on ARM
       bool "ATSAME5x/D5x series GPIOs"

config GPIO_STM32H7XX
       depends on ARM
       bool "STM32H7xx series GPIOs"

config GPIO_TI_F28X
       depends on C2000
       bool "TI TMS320F28x series GPIOs"

config GPIO_TINYAVR
       depends on AVR
       bool "TinyAVR/ATTiny series GPIOs"

config GPIO_RENESAS_RA4
       depends on ARM
       bool "Renesas RA4 GPIOs"

config GPIO_NXP_SIUL2
       depends on POWERPC
       bool "NXP SIUL2 GPIOs"

endmenu
```

## drivers/misc/Kconfig
```kconfig
menu "Misc. drivers"

config MISC_PIC32MX
       depends on MIPS
       bool "PIC32Mx system protected registers support"

config MISC_RP2040_RESET
       depends on ARM
       bool "RP2040 reset system support"

config MISC_STM32H7XX_DMAMUX
       depends on ARM
       bool "STM32H7XX DMAMUX support"

endmenu
```

## drivers/mux/Kconfig
```kconfig
menu "MUX drivers"

config MUX_AVR
       depends on AVR
       bool "AVR/ATMega series MUX"

config MUX_GD32VF103
       depends on RISCV
       bool "GD32VF103 series MUX"

config MUX_PIC32MX
       depends on MIPS
       bool "PIC32Mx series MUX"

config MUX_RP2040
       depends on ARM
       bool "Rapspberry RP2040 series MUX"

config MUX_ATSAM3X
       depends on ARM
       bool "ATSAM3x series MUX"

config MUX_ATSAME5X
       depends on ARM
       bool "ATSAME5x/D5x series MUX"

config MUX_STM32H7XX
       depends on ARM
       bool "STM32H7xx series MUX"

config MUX_TI_F28X
       depends on C2000
       bool "TI TMS320F28x series MUX"

config MUX_TINYAVR
       depends on AVR
       bool "TinyAVR/ATTiny series MUX"

endmenu
```

## drivers/pwm/Kconfig
```kconfig
menu "PWM drivers"

config PWM_AVR
       depends on AVR
       bool "AVR/ATMega series PWMs"

config PWM_GD32VF103
       depends on RISCV
       bool "GD32VF103 series PWMs"

config PWM_PIC32MX
       depends on MIPS
       bool "PIC32Mx series PWMs"

config PWM_RP2040
       depends on ARM
       bool "Rapspberry RP2040 series PWMs"

config PWM_ATSAM3X
       depends on ARM
       bool "ATSAM3x series PWMs"

config PWM_ATSAM3X_TC
       depends on ARM
       bool "ATSAM3x series PWMs on TC"

config PWM_ATSAME5X
       depends on ARM
       bool "ATSAME5x/D5x series PWMs"

config PWM_STM32H7XX
       depends on ARM
       bool "STM32H7xx series PWMs"

config PWM_TI_EPWM
       depends on C2000
       bool "TI C2000 ePWM"

config PWM_TINYAVR
       depends on AVR
       bool "TinyAVR/ATTiny series PWMs"

config PWM_RENESAS_RA4_GPT
       depends on ARM
       bool "Renesas RA4 GPT PWM"

config PWM_NXP_EMIOS
       depends on POWERPC
       bool "NXP eMIOS PWM"

endmenu
```

## drivers/spi/Kconfig
```kconfig
menu "SPI drivers"

config SPI_ARM_PL022
       depends on ARM
       bool "ARM PL022 SPI"

config SPI_ATMEL_SERCOM
       depends on ARM
       bool "Atmel SERCOM SPI"

config SPI_AVR
       depends on AVR
       bool "AVR/ATMega series SPI"

config SPI_AVR_USART
       depends on AVR
       bool "AVR/ATMega series SPIM on USART"

config SPI_GD32VF103
       depends on RISCV
       bool "GD32VF103 series SPI"

config SPI_PIC32MX
       depends on MIPS
       bool "PIC32Mx series SPI"

config SPI_ATSAM3X
       depends on ARM
       bool "ATSAM3x series SPI"

config SPI_STM32H7XX
       depends on ARM
       bool "STM32H7xx series SPI"

config SPI_TI_F28X
       depends on C2000
       bool "TI TMS320F28x series SPI"

config SPI_TINYAVR
       depends on AVR
       bool "TinyAVR/ATTiny series SPI"

config SPI_RENESAS_RA4
       depends on ARM
       bool "Renesas RA4 SPI"

endmenu
```

## drivers/twi/Kconfig
```kconfig
menu "TWI/I2C drivers"

config TWI_ATMEL_SERCOM
       depends on ARM
       bool "Atmel SERCOM TWI"

config TWI_AVR
       depends on AVR
       bool "AVR/ATMega series TWI"

config TWI_DW_APB_I2C
       depends on ARM
       bool "Synopsis DW APB I2C"

config TWI_PIC32MX
       depends on MIPS
       bool "PIC32Mx series TWI"

config TWI_ATSAM3X
       depends on ARM
       bool "ATSAM3x series TWI"

config TWI_TI_F28X
       depends on C2000
       bool "TI TMS320F28x series TWI"

endmenu
```

## drivers/uart/Kconfig
```kconfig
menu "UART drivers"

config UART_ARM_PL011
       depends on ARM
       bool "ARM PL011 UART"

config UART_ATMEL_SERCOM
       depends on ARM
       bool "Atmel SERCOM UART"

config UART_AVR
       depends on AVR
       bool "AVR/ATMega series UART"

config UART_AVR_IRQDRIVEN
       depends on UART_AVR
       bool "Support for IRQ-driven options"

config UART_GD32VF103
       depends on RISCV
       bool "GD32VF103 series UART"

config UART_PIC32MX
       depends on MIPS
       bool "PIC32Mx series UART"

config UART_ATSAM3X
       depends on ARM
       bool "ATSAM3x series UART"

config UART_STM32H7XX
       depends on ARM
       bool "STM32H7xx series UART"

config UART_TINYAVR_USART
       depends on AVR
       bool "TinyAVR/ATTiny series UART/USART"

config UART_RENESAS_RA4_SCI
       depends on ARM
       bool "Renesas RA4 UART SCI"

config UART_NXP_LINFLEXD
       depends on POWERPC
       bool "NXP LinFlexD UART"

endmenu
```

## drivers/wd/Kconfig
```kconfig
menu "Watchdog drivers"

config WD_AVR
       depends on AVR
       bool "AVR/ATMega Watchdog"

config WD_GD32VF103_FWDGT
       depends on RISCV
       bool "GD32VF103 FWDGT Watchdog"

config WD_PIC32MX
       depends on MIPS
       bool "PIC32Mx Watchdog"

config WD_RP2040
       depends on ARM
       bool "Raspberry RP2040 Watchdog"

config WD_ATSAM3X
       depends on ARM
       bool "ATSAM3x series Watchdog"

config WD_ATSAME5X
       depends on ARM
       bool "ATSAME5x/D5x series Watchdog"

config WD_STM32H7XX_IWDG
       depends on ARM
       bool "STM32H7xx IWDG Watchdog"

config WD_TI_F28X
       depends on C2000
       bool "TI TMS320F28x series Watchdog"

config WD_TINYAVR
       depends on AVR
       bool "TinyAVR/ATTiny Watchdog"

endmenu
```

## ipc/Kconfig
```kconfig
menu "Inter-Process communications"

config FUTEX
       bool "Support for futexes (fast mutexes)"
       default n
       help
          Futexes are the most basic IPC you can think of. They
	  are non re-entrant.
	  
config MUTEX
       bool "Support for mutexes"
       default n
       help
          On OpenPicoRTOS, mutexes are similar to futexes, but
	  re-entrant.

config COND
       bool "Support for conditions"
       default n
       select MUTEX
       help
          Conditions are similar to POSIX conditions & require
	  mutexes

config QUEUE
       bool "Support for queues"
       default n
       select FUTEX
       help
          Queues are used to make FIFOs. Warning: issues with
	  caches are not solved yet

endmenu
```

## staging/Kconfig
```kconfig
config STAGING
       bool "Support for staging tree"

menu "Staging tree"
     depends on STAGING

source staging/drivers/adc/Kconfig
source staging/drivers/can/Kconfig
source staging/drivers/clock/Kconfig
source staging/drivers/dma/Kconfig
source staging/drivers/dmasg/Kconfig
source staging/drivers/flash/Kconfig
source staging/drivers/gpio/Kconfig
source staging/drivers/lin/Kconfig
source staging/drivers/misc/Kconfig
source staging/drivers/mux/Kconfig
source staging/drivers/pwm/Kconfig
source staging/drivers/spi/Kconfig
source staging/drivers/twi/Kconfig
source staging/drivers/uart/Kconfig
# source staging/drivers/wd/Kconfig

endmenu
```

## staging/drivers/adc/Kconfig
```kconfig
menu "ADC drivers"

config ADC_GD32VF103
       depends on RISCV
       bool "GD32VF103 series ADC"

config ADC_NXP_EQADC
       depends on POWERPC
       bool "NXP eQADC"

config ADC_MC9S08PTXX
       depends on HCS08
       bool "NXP MC9S08PTxx series ADC"

config ADC_N76E003_SAR
       depends on 8051
       bool "Nuvoton N76E003 series ADC"
       
config ADC_CH552
       depends on 8051
       bool "WCH CH552 series ADC"

endmenu
```

## staging/drivers/can/Kconfig
```kconfig
menu "CAN drivers"

config CAN_GD32VF103
       depends on RISCV
       bool "GD32VF103 series CAN"

config CAN_PIC32MX
       depends on MIPS
       bool "PIC32Mx series CAN"

config CAN_ATSAME5X
       depends on ARM
       bool "ATSAME5X series CAN"

config CAN_STM32H7XX_FDCAN
       depends on ARM
       bool "STM32H7xx series FDCAN"

endmenu
```

## staging/drivers/clock/Kconfig
```kconfig
menu "Clock drivers"

config CLOCK_LGT8FX8P
       depends on AVR
       bool "LogicGreen LGT8FX8P clock"

config CLOCK_STM32F10XXX
       depends on ARM
       bool "STMicro STM32F10xxx series clock"

config CLOCK_STM32F401X
       depends on ARM
       bool "STMicro STM32F401x series clock"

config CLOCK_STM32L4X
       depends on ARM
       bool "STMicro STM32L4x series clock"

config CLOCK_STC12C5AXX
       depends on 8051
       bool "STC MCU STC12C5Axx series clock"

config CLOCK_CH32V003
       depends on RISCV
       bool "WCH CH32V003 series clock"

config CLOCK_MC9S08PTXX
       depends on HCS08
       bool "NXP MC9S08PTxx series clock"

config CLOCK_STM8
       depends on STM8
       bool "STMicro STM8 series clock"

endmenu
```

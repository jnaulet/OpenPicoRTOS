## arch/Kconfig
```kconfig
choice
        prompt "Architecture select"
        default ARM

config 8051
        bool "8051 architecture"
        select DISABLE_SINGLE_CORE
        select DISABLE_SMP

config ARM
        bool "ARM architecture"

config AVR
        bool "AVR8 architecture"
        select DISABLE_SMP

config C2000
        bool "C2000 architecture"
        select DISABLE_SMP

config HCS08
        bool "HCS08 architecture"
        select DISABLE_SINGLE_CORE
        select DISABLE_SMP

config MIPS
        bool "MIPS architecture"

config MSP430
        bool "MSP430 architecture"
        select DISABLE_SINGLE_CORE
        select DISABLE_SMP

config POWERPC
        bool "PowerPC architecture"

config RISCV
        bool "RISC-V architecture"

config STM8
        bool "STM8 architecture"
        select DISABLE_SINGLE_CORE
        select DISABLE_SMP

config Z80
        bool "Z80 architecture"
        select DISABLE_SINGLE_CORE
        select DISABLE_SMP

config PTHREAD
        bool "PTHREAD simulation"

config WIN32
        bool "WIN32 simulation"

endchoice

config CC
        string
        default "gcc" if ARM || AVR || MIPS || MSP430 || POWERPC || RISCV || PTHREAD || WIN32
        default "sdcc" if 8051 || HCS08 || STM8 || Z80
        default "cl2000" if C2000

config CC_GCC
        bool
        default y if CC="gcc"

config CC_SDCC
        bool
        default y if CC="sdcc"

config CC_CL2000
        bool
        default y if CC="cl2000"

source "arch/8051/Kconfig"
source "arch/arm/Kconfig"
source "arch/avr/Kconfig"
source "arch/c2000/Kconfig"
source "arch/hcs08/Kconfig"
source "arch/mips/Kconfig"
source "arch/msp430/Kconfig"
source "arch/powerpc/Kconfig"
source "arch/riscv/Kconfig"
source "arch/stm8/Kconfig"
source "arch/z80/Kconfig"
source "arch/pthread/Kconfig"
```

## arch/arm/armv6-m/Kconfig
```kconfig
choice
	prompt "ARMV6-M device"
	depends on ARMV6M

config MACH_RP2040
       bool "Raspberry RP2040"
       
endchoice

config MPU_PMSAV6
	bool "MPU support (EXPERIMENTAL)"
	depends on ARMV6M
        default n
	select MPU
```

## arch/msp430/Kconfig
```kconfig
menu "MSP430 architecture"
        depends on MSP430

choice
        prompt "Select device"

config MACH_MSP430G2553
        bool "TI MSP430G2553"
        select FIXED_TICK_HZ

endchoice

config ACLK_FREQ
        int "ACLK frequency in hz"
        default 12000
	help
	    CONFIG_TICK_HZ frequency will be ACLK_FREQ / 64

endmenu
```

## arch/powerpc/Kconfig
```kconfig
menu "PowerPC architecture"
	depends on POWERPC

choice
       prompt "PowerPC series"

config E200Z4
       bool "PowerPC e200z4 series"
       select CACHE

config E200Z7
       bool "PowerPC e200z7 series"

endchoice

choice
	prompt "Device"

config MACH_MPC574X
       bool "NXP MPC574x series"
       depends on E200Z4

config MACH_MPC577X
       bool "NXP MPC577x series"
       depends on E200Z7

endchoice

config CACHE_MAINTENANCE
       bool "Cache maintenance operations"
       depends on E200Z7
       default n
       select CACHE

config MPU_SMPU
       bool "MPU support (EXPERIMENTAL)"
       depends on E200Z4
       default n
       select MPU

config DEBUG_AUX_CORE_STARTUP
       bool "Debug auxiliary core startup (Warning: not for production)"
       depends on SMP
       default n

endmenu
```

## arch/z80/Kconfig
```kconfig
menu "Z80 architecture"
     depends on Z80

choice
        prompt "MCU series"
        default MACH_ZXSPECTRUM

config MACH_ZXSPECTRUM
       bool "Sinclair ZX Spectrum series"
       
endchoice

endmenu
```

## drivers/rng/Kconfig
```kconfig
menu "RNG drivers"

config RNG_XORSHIFT32
       bool "George Marsaglia's xorshift32 pseudo-random RNG"
       
config RNG_ATSAMX7X
       bool "Atmel atsamx7x series TRNG"

endmenu
```

## scheduler/Kconfig
```kconfig
menu "Scheduler options"

choice
	prompt "Main scheduler"

config SINGLE_CORE
       bool "picoRTOS (single core)" if !CC_SDCC

config SMP
       bool "picoRTOS-SMP (SMP)" if !CC_SDCC

config LITE
       bool "picoRTOS-lite (single core, no round-robin)"

endchoice

config CORE_COUNT
       int
       prompt "Number of cores (SMP)" if SMP
       default 1 if SINGLE_CORE || LITE
       default 2 if SMP
       help
          The numbers of cores on which the system will run

endmenu
```

## test/static_analysis/picoRTOS-SMP/configs/mach-rp2040_defconfig
```kconfig
CONFIG_ARM=y
CONFIG_ARMV6M=y
CONFIG_MACH_RP2040=y
CONFIG_MPU_PMSAV6=y
CONFIG_MPU=y
```

## test/static_analysis/picoRTOS/configs/mach-atsamx7x_defconfig
```kconfig
CONFIG_ARM=y
CONFIG_ARMV7EM=y
CONFIG_MACH_ATSAMX7X=y
CONFIG_FPV4_SP_D16=y
CONFIG_L1_CACHE_LINESIZE=32
CONFIG_CACHE_MAINTENANCE=y
CONFIG_MPU_PMSAV7=y
CONFIG_CACHE=y
CONFIG_MPU=y
```

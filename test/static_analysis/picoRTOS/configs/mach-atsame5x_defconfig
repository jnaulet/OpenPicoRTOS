## test/static_analysis/picoRTOS/configs/mach-ch32v003_defconfig
```kconfig
CONFIG_RISCV=y
CONFIG_RV32EC=y
CONFIG_MACH_CH32V003=y
CONFIG_RV32EC_LIBGCC_DIV_MULT=y
```

## test/static_analysis/picoRTOS/configs/mach-mc9s08ptxx_defconfig
```kconfig
CONFIG_HCS08=y
CONFIG_MACH_MC9S08PT60=y
CONFIG_MACH_MC9S08PTXX=y
CONFIG_SYSTICK_MC9S08PTXX_RTC=y
```

## test/static_analysis/picoRTOS/configs/mach-mpc574x_defconfig
```kconfig
CONFIG_POWERPC=y
CONFIG_CACHE_MAINTENANCE=y
CONFIG_E200Z4=y
CONFIG_MACH_MPC574X=y
```

## test/static_analysis/picoRTOS/configs/mach-pic32mz_defconfig
```kconfig
CONFIG_MIPS=y
CONFIG_M51XX=y
CONFIG_MACH_PIC32MZ=y
CONFIG_M51XX_DSP=y
CONFIG_M51XX_FPU64=y
```

## test/static_analysis/picoRTOS/configs/mach-stc12c5axx_defconfig
```kconfig
CONFIG_8051=y
CONFIG_MACH_STC12C5AXX=y
CONFIG_SYSCLK_HZ=22100000
CONFIG_SYSCLK_DIV=1
```

## test/static_analysis/picoRTOS/configs/mach-stm32h7xx_defconfig
```kconfig
CONFIG_ARM=y
CONFIG_ARMV7EM=y
CONFIG_MACH_STM32H7XX=y
CONFIG_FPV4_SP_D16=y
CONFIG_L1_CACHE_LINESIZE=32
CONFIG_CACHE_MAINTENANCE=y
```

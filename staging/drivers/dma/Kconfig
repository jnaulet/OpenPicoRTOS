## staging/drivers/dmasg/Kconfig
```kconfig
menu "DMA-SG drivers"

config DMASG_NXP_EDMA
       depends on POWERPC
       bool "NXP eDMA DMA-SG"

endmenu
```

## staging/drivers/flash/Kconfig
```kconfig
menu "FLash drivers"

config FLASH_NXP_C55FMC
       depends on POWERPC
       bool "NXP C55FMC Flash"

config FLASH_ATSAM3X
       depends on ARM
       bool "Atmel SAM3x Flash"

endmenu
```

## staging/drivers/gpio/Kconfig
```kconfig
menu "GPIO drivers"

config GPIO_8051
       depends on 8051
       bool "8051-compatible GPIOs"

config GPIO_N76E003
       depends on 8051
       bool "Nuvoton N76E003 series GPIOs"

config GPIO_STM32F10XXX
       depends on ARM
       bool "STMicro STM32F10XXX series GPIOs"

config GPIO_WCH_CH32X
       depends on RISCV
       bool "WCH CH32x series GPIOs"

config GPIO_MC9S08PTXX
       depends on HCS08
       bool "NXP MC9S08PTxx series GPIOs"

config GPIO_STM8
       depends on STM8
       bool "STMicro STM8 series GPIOs"

endmenu
```

## staging/drivers/lin/Kconfig
```kconfig
menu "LIN drivers"

config LIN_NXP_LINFLEXD
       depends on POWERPC
       bool "NXP LinFlexD LIN"

endmenu
```

## staging/drivers/misc/Kconfig
```kconfig
menu "Misc. drivers"

config MISC_NXP_IGF
       depends on POWERPC
       bool "NXP IGF filter"

endmenu
```

## staging/drivers/mux/Kconfig
```kconfig
menu "MUX drivers"

config MUX_8051
       depends on 8051
       bool "8051-compatible MUX"

config MUX_N76E003
       depends on 8051
       bool "Nuvoton N76E003 series MUX"

config MUX_STM32F10XXX
       depends on ARM
       bool "STMicro STM32F10XXX series MUX"

config MUX_WCH_CH32X
       depends on RISCV
       bool "WCH CH32x series MUX"

config MUX_MC9S08PTXX
       depends on HCS08
       bool "NXP MC9S08PTxx series MUX"

config MUX_STM8
       depends on STM8
       bool "STMicro STM8 series MUX"

endmenu
```

## staging/drivers/pwm/Kconfig
```kconfig
menu "PWM drivers"

config PWM_MC9S08PTXX_FTM
       depends on HCS08
       bool "NXP MC9S08PTxx FTM series PWMs"

config PWM_N76E003
       depends on 8051
       bool "Nuvoton N76E003 series PWMs"

config PWM_CH552
       depends on 8051
       bool "WCH CH552 series PWMs"

endmenu
```

## staging/drivers/rng/Kconfig
```kconfig
menu "RNG drivers"

config RNG_STM32H7XX_TRNG
       depends on ARM
       bool "STM32H7xx True Random Number Generator"

endmenu
```

## staging/drivers/spi/Kconfig
```kconfig
menu "SPI drivers"

config SPI_MC9S08PTXX
       depends on HCS08
       bool "NXP MC9S08PTxx Series SPI"

config SPI_N76E003
       depends on 8051
       bool "Nuvoton N76E003 Series SPI"

config SPI_CH552
       depends on 8051
       bool "WCH CH552 Series SPI"

endmenu
```

## staging/drivers/twi/Kconfig
```kconfig
menu "TWI drivers"

config TWI_GD32VF103
       depends on RISCV
       bool  "GD32VF103 series TWI"

config TWI_NXP_I2C
       depends on POWERPC
       bool "NXP I2C"

config TWI_STM32H7XX
       depends on ARM
       bool "STM32H7xx series TWI"

endmenu
```

## staging/drivers/uart/Kconfig
```kconfig
menu "UART drivers"

config UART_N76E003
       depends on 8051
       bool "Nuvoton N76E003 series UART"

config UART_8051
       depends on 8051
       bool "8051-compatible UART"

config UART_8051_IRQDRIVEN
       depends on UART_8051
       bool "Support for IRQ-driven options"

config UART_MC9S08PTXX
       depends on HCS08
       bool "NXP MC9S08PTxx series SCI UART"

endmenu
```

## staging/drivers/w1/Kconfig
```kconfig
menu "1-Wire drivers"

config W1_UART
       bool "Generic 1-Wire interface over UART"

endmenu
```

## staging/drivers/wd/Kconfig
```kconfig
menu "Watchdog drivers"

config WD_RENESAS_RA4_WDT
       depends on ARM
       bool "Renesas RA4 WDT Watchdog"

config WD_MC9S08PTXX_WDOG
       depends on HCS08
       bool "NXP MC9S08PTxx Series Watchdog"

endmenu
```
